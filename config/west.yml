## config/west.yml
```yaml
manifest:
  remotes:
  - name: zmkfirmware
    url-base: https://github.com/zmkfirmware

  projects:
  - name: zmk
    remote: zmkfirmware
    revision: v0.3
    import: app/west.yml
  - name: cirque-input-module
    url: https://github.com/ArtemYurov/cirque-input-module
    revision: feature/axis-rotation
    path: modules/cirque-input-module
  - name: zmk-central-states-relay
    url: https://github.com/ArtemYurov/zmk-central-states-relay
    revision: main
  - name: nice-view-central-relay
    url: https://github.com/ArtemYurov/nice-view-central-relay
    revision: zmk-v0.3
  self:
    path: config
```

## config/west.yml
```yaml
manifest:
  remotes:
  - name: zmkfirmware
    url-base: https://github.com/zmkfirmware

  projects:
  - name: zmk
    url: https://github.com/ArtemYurov/zmk
    revision: test/zmk-0.4-input-listener-fix
    import: app/west.yml
  - name: zmk-central-states-relay
    url: https://github.com/ArtemYurov/zmk-central-states-relay
    revision: main
  - name: nice-view-central-relay
    url: https://github.com/ArtemYurov/nice-view-central-relay
    revision: main
  self:
    path: config
```
